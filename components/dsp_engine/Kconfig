## components/dsp_engine/Kconfig
```kconfig
menu "DSP Engine"

config DSP_CHARACTER_PROFILE
    bool "Enable Analog Character per-stage cycle profiling"
    default n
    help
        Enable per-stage cycle-counter instrumentation for Character DSP.
        This adds cycle-counter reads inside the sample loop and is intended
        only for profiling builds. Keep disabled for normal playback.


config DSP_PEQ_USE_ESP_DSP
    bool "Use ESP-DSP stereo block biquad for PEQ"
    depends on IDF_TARGET_ESP32S3
    default n
    help
        Experimental Phase 3 backend. Converts each PCM block to interleaved
        float, then runs the PEQ cascade with ESP-DSP's stereo biquad kernel.
        This preserves the filter coefficients but uses a DF-II state
        realization instead of the native transposed DF-II implementation.
        Keep disabled for the reference backend. Enable for A/B CPU and
        listening tests before making it the default.

config DSP_PEQ_USE_ESP_DSP_AES3
    bool "Use ESP-DSP dual-mono biquad (ESP32-S3 AES3 eligible)"
    depends on IDF_TARGET_ESP32S3 && !DSP_PEQ_USE_ESP_DSP
    default n
    help
        Experimental A/B backend. Deinterleaves PCM into two planar float
        channels and calls dsps_biquad_f32 for each channel. With a recent
        ESP-DSP package and optimized kernels enabled, the S3-specific
        dsps_biquad_f32_aes3 assembly can be selected. Otherwise the library
        falls back to another available implementation. Keep disabled until
        measured against the native and interleaved-stereo backends.

endmenu
```

## components/spdif_input/Kconfig
```kconfig
menu "HihiFi Optical S/PDIF Input"

    config SPDIF_IN_RMT_RESOLUTION_HZ
        int "RMT resolution (Hz)"
        default 80000000

    config SPDIF_IN_RMT_MEM_BLOCK_SYMBOLS
        int "RMT DMA capture symbols"
        default 4096
        range 1024 16384

    config SPDIF_IN_PCM_BUFFER_SIZE
        int "PCM ring-buffer capacity (bytes)"
        default 32768

    config SPDIF_IN_DECODER_TASK_STACK
        int "Decoder task stack (bytes)"
        default 8192

    config SPDIF_IN_DECODER_TASK_PRIORITY
        int "Decoder task priority"
        default 3

    config SPDIF_IN_DECODER_TASK_CORE
        int "Decoder task core"
        range 0 1
        default 0

    config SPDIF_IN_HISTOGRAM_BIN_COUNT
        int "Histogram bins"
        default 256

    config SPDIF_IN_MAX_PULSE_WIDTH_NS
        int "Maximum pulse width tracked (ns)"
        default 2000

    config SPDIF_IN_MIN_SAMPLES_FOR_ANALYSIS
        int "Minimum timing samples"
        default 10000

    config SPDIF_IN_PULSE_RATIO_TOLERANCE_MILLIPCT
        int "Pulse ratio tolerance (milli-fraction)"
        default 150

    config SPDIF_IN_EXPECTED_SHORT_PULSE_PCT_TENTHS
        int "Expected short-pulse distribution (tenths of percent)"
        default 600

    config SPDIF_IN_EXPECTED_MEDIUM_PULSE_PCT_TENTHS
        int "Expected medium-pulse distribution (tenths of percent)"
        default 350

    config SPDIF_IN_EXPECTED_LONG_PULSE_PCT_TENTHS
        int "Expected long-pulse distribution (tenths of percent)"
        default 50

    config SPDIF_IN_DISTRIBUTION_TOLERANCE_PCT
        int "Pulse distribution tolerance (percent)"
        default 100

endmenu
```

## main/Kconfig.projbuild
```kconfig
menu "HihiFi Optical Input"

    config HIFI_SPDIF_INPUT_ENABLE
        bool "Enable Optical S/PDIF input"
        default y

    config HIFI_SPDIF_INPUT_GPIO
        int "Optical receiver DATA GPIO"
        depends on HIFI_SPDIF_INPUT_ENABLE
        range 0 48
        default 4
        help
            Connect the logic-level DATA output of the TOSLINK receiver module.
            GPIO4 is a provisional default for ESP32-S3; verify your board wiring.

endmenu
```
